#nolist

#BYTE	TOSU			= 0xFFF
#BYTE	TOSH			= 0xFFE
#BYTE	TOSL			= 0xFFD
#BYTE	STKPTR			= 0xFFC
#BYTE	PCLATU			= 0xFFB
#BYTE	PCLATH			= 0xFFA
#BYTE	PCL				= 0xFF9
#BYTE	TBLPTRU			= 0xFF8
#BYTE	TBLPTRH			= 0xFF7
#BYTE	TBLPTRL			= 0xFF6
#BYTE	TABLAT			= 0xFF5
#BYTE	PRODH			= 0xFF4
#BYTE	PRODL			= 0xFF3
#BYTE	INTCON			= 0xFF2
#BYTE	INTCON2			= 0xFF1
#BYTE	INTCON3			= 0xFF0
#BYTE	INDF0			= 0xFEF
#BYTE	POSTINC0		= 0xFEE
#BYTE	POSTDEC0		= 0xFED
#BYTE	PREINC0			= 0xFEC
#BYTE	PLUSW0			= 0xFEB
#BYTE	FSR0H			= 0xFEA
#BYTE	FSR0L			= 0xFE9
#BYTE	WREG			= 0xFE8
#BYTE	INDF1			= 0xFE7
#BYTE	POSTINC1		= 0xFE6
#BYTE	POSTDEC1		= 0xFE5
#BYTE	PREINC1			= 0xFE4
#BYTE	PLUSW1			= 0xFE3
#BYTE	FSR1H			= 0xFE2
#BYTE	FSR1L			= 0xFE1
#BYTE	BSR				= 0xFE0
#BYTE	INDF2			= 0xFDF
#BYTE	POSTINC2		= 0xFDE
#BYTE	POSTDEC2		= 0xFDD
#BYTE	PREINC2			= 0xFDC
#BYTE	PLUSW2			= 0xFDB
#BYTE	FSR2H			= 0xFDA
#BYTE	FSR2L			= 0xFD9
#BYTE	STATUS			= 0xFD8
#BYTE	TMR0H			= 0xFD7
#BYTE	TMR0L			= 0xFD6
#BYTE	T0CON			= 0xFD5

#BYTE	OSCCON			= 0xFD3
#BYTE	LVDCON			= 0xFD2
#BYTE	WDTCON			= 0xFD1
#BYTE	RCON			= 0xFD0
#BYTE	TMR1H			= 0xFCF
#BYTE	TMR1L			= 0xFCE
#BYTE	T1CON			= 0xFCD
#BYTE	TMR2			= 0xFCC
#BYTE	PR2				= 0xFCB
#BYTE	T2CON			= 0xFCA
#BYTE	SSPBUF			= 0xFC9
#BYTE	SSPADD			= 0xFC8
#BYTE	SSPSTAT			= 0xFC7
#BYTE	SSPCON			= 0xFC6

#BYTE	ADRESH			= 0xFC4
#BYTE	ADRESL			= 0xFC3
#BYTE	ADCON0			= 0xFC2
#BYTE	ADCON1			= 0xFC1
#BYTE	ADCON2			= 0xFC0

#BYTE	CCPR1H			= 0xFBF
#BYTE	CCPR1L			= 0xFBE
#BYTE	CCP1CON			= 0xFBD
#BYTE	CCPR2H			= 0xFBC
#BYTE	CCPR2L			= 0xFBB
#BYTE	CCP2CON			= 0xFBA
#BYTE	ANSEL1			= 0xFB9
#BYTE	ANSEL0			= 0xFB8
#BYTE	T5CON			= 0xFB7
#BYTE	QEICON			= 0xFB6

#BYTE	SPBRGH			= 0xFB0
#BYTE	SPBRG			= 0xFAF
#BYTE	RCREG			= 0xFAE
#BYTE	TXREG			= 0xFAD
#BYTE	TXSTA			= 0xFAC
#BYTE	RCSTA			= 0xFAB
#BYTE	BAUDCTL			= 0xFAA
#BYTE	EEADR			= 0xFA9
#BYTE	EEDATA			= 0xFA8
#BYTE	EECON2			= 0xFA7
#BYTE	EECON1			= 0xFA6
#BYTE	IPR3			= 0xFA5
#BYTE	PIR3			= 0xFA4
#BYTE	PIE3			= 0xFA3
#BYTE	IPR2			= 0xFA2
#BYTE	PIR2			= 0xFA1
#BYTE	PIE2			= 0xFA0
#BYTE	IPR1			= 0xF9F
#BYTE	PIR1			= 0xF9E
#BYTE	PIE1			= 0xF9D

#BYTE	OSCTUNE			= 0xF9B
#BYTE	ADCON3			= 0xF9A
#BYTE	ADCHS			= 0xF99

#BYTE	TRISE			= 0xF96
#BYTE	TRISD			= 0xF95
#BYTE	TRISC			= 0xF94
#BYTE	TRISB			= 0xF93
#BYTE	TRISA			= 0xF92
#BYTE	PR5H			= 0xF91
#BYTE	PR5L			= 0xF90

#BYTE	LATE			= 0xF8D
#BYTE	LATD			= 0xF8C
#BYTE	LATC			= 0xF8B
#BYTE	LATB			= 0xF8A
#BYTE	LATA			= 0xF89
#BYTE	TMR5H			= 0xF88
#BYTE	TMR5L			= 0xF87

#BYTE	PORTE			= 0xF84
#BYTE	PORTD			= 0xF83
#BYTE	PORTC			= 0xF82
#BYTE	PORTB			= 0xF81
#BYTE	PORTA			= 0xF80
#BYTE	PTCON0			= 0xF7F
#BYTE	PTCON1			= 0xF7E

long	PTMR;
#BYTE	PTMR			= 0xF7C
#BYTE	PTMRL			= 0xF7D
#BYTE	PTMRH			= 0xF7C

long	PTPER;
#BYTE	PTPER			= 0xF7A
#BYTE	PTPERL			= 0xF7B
#BYTE	PTPERH			= 0xF7A

long	PDC0;
#BYTE	PDC0			= 0xF78
#BYTE	PDC0L			= 0xF79
#BYTE	PDC0H			= 0xF78

#BYTE	PDC1L			= 0xF77
#BYTE	PDC1H			= 0xF76
#BYTE	PDC2L			= 0xF75
#BYTE	PDC2H			= 0xF74
#BYTE	PDC3L			= 0xF73
#BYTE	PCD3H			= 0xF72
#BYTE	SEVTCMPL		= 0xF71
#BYTE	SEVTCMPH		= 0xF70
#BYTE	PWMCON0			= 0xF6F
#BYTE	PWMCON1			= 0xF6E
#BYTE	DTCON			= 0xF6D
#BYTE	FLTCONFIG		= 0xF6C
#BYTE	OVDCOND			= 0xF6B
#BYTE	OVDCONS			= 0xF6A

#BYTE	CAP1BUFH		= 0xF69
#BYTE	CAP1BUFL		= 0xF68
long	VELR;
#BYTE	VELR			= 0xF68
#BYTE	VELRH			= 0xF69
#BYTE	VELRL			= 0xF68

#BYTE	CAP2BUFH		= 0xF67
#BYTE	CAP2BUFL		= 0xF66
long 	POSCNT;
#BYTE	POSCNT			= 0xF66
#BYTE	POSCNTH			= 0xF67
#BYTE	POSCNTL			= 0xF66

#BYTE	CAP3BUFH		= 0xF65
#BYTE	CAP3BUFL		= 0xF64
long	MAXCNT;
#BYTE	MAXCNT			= 0xF64
#BYTE	MAXCNTH			= 0xF65
#BYTE	MAXCNTL			= 0xF64

#BYTE	CAP1CON			= 0xF63
#BYTE	CAP2CON			= 0xF62
#BYTE	CAP3CON			= 0xF61
#BYTE	DFLTCON			= 0xF60

#BIT	EEPGD			= EECON1.7
#BIT	CFGS			= EECON1.6
#BIT	FREE			= EECON1.4
#BIT	WRERR			= EECON1.3
#BIT	WREN			= EECON1.2
#BIT	WR  			= EECON1.1
#BIT	RD  			= EECON1.0
#BIT	GIE				= INTCON.7

#list
