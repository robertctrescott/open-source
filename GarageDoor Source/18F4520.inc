#nolist

#BYTE	TOSU			= 0xFFF
#BYTE	TOSH			= 0xFFE
#BYTE	TOSL			= 0xFFD
#BYTE	STKPTR			= 0xFFC
#BYTE	PCLATU			= 0xFFB
#BYTE	PCLATH			= 0xFFA
#BYTE	PCL				= 0xFF9
#BYTE	TBLPTRU			= 0xFF8
#BYTE	TBLPTRH			= 0xFF7
#BYTE	TBLPTRL			= 0xFF6
#BYTE	TABLAT			= 0xFF5
#BYTE	PRODH			= 0xFF4
#BYTE	PRODL			= 0xFF3
#BYTE	INTCON			= 0xFF2
#BYTE	INTCON2			= 0xFF1
#BYTE	INTCON3			= 0xFF0
#BYTE	INDF0			= 0xFEF
#BYTE	POSTINC0		= 0xFEE
#BYTE	POSTDEC0		= 0xFED
#BYTE	PREINC0			= 0xFEC
#BYTE	PLUSW0			= 0xFEB
#BYTE	FSR0H			= 0xFEA
#BYTE	FSR0L			= 0xFE9
#BYTE	WREG			= 0xFE8
#BYTE	INDF1			= 0xFE7
#BYTE	POSTINC1		= 0xFE6
#BYTE	POSTDEC1		= 0xFE5
#BYTE	PREINC1			= 0xFE4
#BYTE	PLUSW1			= 0xFE3
#BYTE	FSR1H			= 0xFE2
#BYTE	FSR1L			= 0xFE1
#BYTE	BSR				= 0xFE0
#BYTE	INDF2			= 0xFDF
#BYTE	POSTINC2		= 0xFDE
#BYTE	POSTDEC2		= 0xFDD
#BYTE	PREINC2			= 0xFDC
#BYTE	PLUSW2			= 0xFDB
#BYTE	FSR2H			= 0xFDA
#BYTE	FSR2L			= 0xFD9
#BYTE	STATUS			= 0xFD8
#BYTE	TMR0H			= 0xFD7
#BYTE	TMR0L			= 0xFD6
#BYTE	T0CON			= 0xFD5
#BYTE	OSCCON			= 0xFD3
#BYTE	LVDCON			= 0xFD2
#BYTE	WDTCON			= 0xFD1
#BYTE	RCON			= 0xFD0
#BYTE	TMR1H			= 0xFCF
#BYTE	TMR1L			= 0xFCE
#BYTE	T1CON			= 0xFCD
#BYTE	TMR2			= 0xFCC
#BYTE	PR2				= 0xFCB
#BYTE	T2CON			= 0xFCA
#BYTE	SSPBUF			= 0xFC9
#BYTE	SSPADD			= 0xFC8
#BYTE	SSPSTAT			= 0xFC7
#BYTE	SSPCON1			= 0xFC6
#BYTE	SSPCON2			= 0xFC5
#BYTE	ADRESH			= 0xFC4
#BYTE	ADRESL			= 0xFC3
#BYTE	ADCON0			= 0xFC2
#BYTE	ADCON1			= 0xFC1
#BYTE	CCPR1H			= 0xFBF
#BYTE	CCPR1L			= 0xFBE
#BYTE	CCP1CON			= 0xFBD
#BYTE	CCPR2H			= 0xFBC
#BYTE	CCPR2L			= 0xFBB
#BYTE	CCP2CON			= 0xFBA
#BYTE	TMR3H			= 0xFB3
#BYTE	TMR3L			= 0xFB2
#BYTE	T3CON			= 0xFB1
#BYTE	SPBRG			= 0xFAF
#BYTE	RCREG			= 0xFAE
#BYTE	TXREG			= 0xFAD
#BYTE	TXSTA			= 0xFAC
#BYTE	RCSTA			= 0xFAB
#BYTE	EEADR			= 0xFA9
#BYTE	EEDATA			= 0xFA8
#BYTE	EECON2			= 0xFA7
#BYTE	EECON1			= 0xFA6
#BYTE	IPR2			= 0xFA2
#BYTE	PIR2			= 0xFA1
#BYTE	PIE2			= 0xFA0
#BYTE	IPR1			= 0xF9F
#BYTE	PIR1			= 0xF9E
#BYTE	PIE1			= 0xF9D
#BYTE	TRISE			= 0xF96
#BYTE	TRISD			= 0xF95
#BYTE	TRISC			= 0xF94
#BYTE	TRISB			= 0xF93
#BYTE	TRISA			= 0xF92
#BYTE	LATE			= 0xF8D
#BYTE	LATD			= 0xF8C
#BYTE	LATC			= 0xF8B
#BYTE	LATB			= 0xF8A
#BYTE	LATA			= 0xF89
#BYTE	PORTE			= 0xF84
#BYTE	PORTD			= 0xF83
#BYTE	PORTC			= 0xF82
#BYTE	PORTB			= 0xF81
#BYTE	PORTA			= 0xF80
#BIT	EEPGD			= EECON1.7
#BIT	CFGS			= EECON1.6
#BIT	FREE			= EECON1.4
#BIT	WRERR			= EECON1.3
#BIT	WREN			= EECON1.2
#BIT	WR  			= EECON1.1
#BIT	RD  			= EECON1.0
#BIT	GIE				= INTCON.7
#BIT	CREN			= RCSTA.4
#BIT	RCIE			= PIE1.5
#BIT	TRMT			= TXSTA.1


#list	
