/******************** (C) COPYRIGHT 2009 e-Design Co.,Ltd. *********************
* File Name: lcd.c      Author: bure      Hardware: DS0201V1.1     Version: V1.0
*******************************************************************************/
#include "lcd.h"
#include "HW_V1_Config.h"
#include "function.h"

unsigned const int Char_Dot[760] =//744
{
   0x0000,0x0000,0x3E00,0x3C00,0x0000,0x3E00,0x3C00,0x0000,/*"    */
   0x0480,0x0480,0x3FF0,0x0480,0x0480,0x3FF0,0x0480,0x0480,/*#    */
   0x0000,0x0000,0x0000,0xE000,0x1000,0x0800,0x0800,0x0800,/*$ No used*/
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   0x0780,0x0480,0x3CF0,0x2010,0x2010,0x2010,0x2010,0x2010 /*~ Empty head*/
};                                            

unsigned const long Logo_Dot[512] ={

0x00000000,0x00000000,0x00000000,0x00000000,0x00000000,0x00000000,0x00000000,0x00000000,
0x00000000,0x00000000,0x00000000,0x00000000,0x00000000,0x00000000,0x00000000,0x00000000,

0x00000000,0x00000000,0x00000000,0x00000000,0x00000000,0x00000000,0x00000000,0x00000000,
0x00000000,0x00000000,0x00000000,0x00000000,0x00000000,0x00000000,0x00000000,0x00000000,

};

/*******************************************************************************
 LCD_WR_REG: Set LCD Register  Input: Register addr., Data
*******************************************************************************/
void LCD_WR_REG(unsigned int Reg, unsigned int Data)
{
  LCD_DATA_OUT=Reg;     //Reg. Addr.
  LCD_RS_LOW();         //RS=0,Piont to Index Reg.
  LCD_nWR_LOW();
  LCD_nWR_HIGH();
  LCD_RS_HIGH();        //RS=1,Piont to object Reg.
  LCD_DATA_OUT=Data;    //Reg. Data
  LCD_nWR_LOW();
  LCD_nWR_HIGH();
}
/*******************************************************************************
 LCD  initializtion
*******************************************************************************/

void LCD_Initial(void)
{
  //------------------------- Reset LCD Driver ---------------------//
  LCD_DATA_BUS_OUT();   //Set LCD Data Bus as Output Mode
  LCD_nWR_HIGH();
  LCD_nRD_HIGH();
  LCD_RS_HIGH();        //RS=1
  LCD_nRST_HIGH();
  Delay_ms(1);           //RST=1£¬Delay 1ms
  LCD_nRST_LOW();
  Delay_ms(1);          //RST=0 Reset LCD£¬Delay 1ms
  LCD_nRST_HIGH();
  Delay_ms(5);          //RST=1£¬Delay 5 ms
 //----------------ST7781 Internal Register Initial------------//
  LCD_WR_REG(0x00FF, 0x0001);
  LCD_WR_REG(0x00F3, 0x0008);
  LCD_DATA_OUT=0x00F3;
  LCD_RS_LOW();
  LCD_nWR_LOW();
  LCD_nWR_HIGH();

  LCD_RS_HIGH();
 //-------------------Display Control Setting-----------------//
  LCD_WR_REG(0x0001, 0x0100);    //Output Direct
  LCD_WR_REG(0x0002, 0x0700);    //Line Inversion
  LCD_WR_REG(0x0003, 0x0030);    //BGR=0,ID=11
  LCD_WR_REG(0x0008, 0x0302);    //Porch Setting
  LCD_WR_REG(0x0009, 0x0000);    //Scan Cycle
  LCD_WR_REG(0x000A, 0x0000);    //FMARK off
 //----------------power Control Register Initial------------//
  LCD_WR_REG(0x0010, 0x0790);    //Power Control1
  LCD_WR_REG(0x0011, 0x0005);    //Power Control2
  LCD_WR_REG(0x0012, 0x0000);    //Power Control3
  LCD_WR_REG(0x0013, 0x0000);    //Power Control4
  Delay_ms(100);                  //Delay 100ms
  LCD_WR_REG(0x0010, 0x12B0);    //Power Control1
  Delay_ms(50);                   //delay 50ms
  LCD_WR_REG(0x0011, 0x0007);    //Power Control2
  Delay_ms(50);                   //delay 50ms
  LCD_WR_REG(0x0012, 0x008C);    //Power Control3
  LCD_WR_REG(0x0013, 0x1700);    //Power Control4
  LCD_WR_REG(0x0029, 0x001A);    //VCOMH Setting
  Delay_ms(50);                   //delay 50ms
 //------------------GAMMA Cluster Setting-------------------//
  LCD_WR_REG(0x0030, 0x0000);
  LCD_WR_REG(0x0031, 0x0507);
  LCD_WR_REG(0x0032, 0x0003);
  LCD_WR_REG(0x0035, 0x0200);
  LCD_WR_REG(0x0036, 0x0106);
  LCD_WR_REG(0x0037, 0x0000);
  LCD_WR_REG(0x0038, 0x0507);
  LCD_WR_REG(0x0039, 0x0104);
  LCD_WR_REG(0x003C, 0x0200);
  LCD_WR_REG(0x003D, 0x0005);
 //------------------Display Windows 240*320-----------------//
  LCD_WR_REG(0x0050, 0x0000);
  LCD_WR_REG(0x0051, 0x00EF);
  LCD_WR_REG(0x0052, 0x0000);
  LCD_WR_REG(0x0053, 0x013F);
 //--------------------Frame Rate Setting--------------------//
  LCD_WR_REG(0x0060, 0xA700);
  LCD_WR_REG(0x0061, 0x0001);
  LCD_WR_REG(0x0090, 0x0033);
  LCD_WR_REG(0x0007, 0x0133);
  Delay_ms(50);                   //delay 50ms
}

/*******************************************************************************
Point_SCR: Set display position   Input: X, Y
*******************************************************************************/
void Point_SCR(unsigned int x0, unsigned int y0)
{
  LCD_WR_REG(0x0020,y0);
  LCD_WR_REG(0x0021,x0);
  LCD_DATA_OUT=0x0022;  //DRAM Reg.
  LCD_RS_LOW();
  LCD_nWR_LOW();
  LCD_nWR_HIGH();
  LCD_nWR_LOW();
  LCD_nWR_HIGH();
  LCD_RS_HIGH();
}
/*******************************************************************************
 Set_Pixel: Set a Pixel  Input: Color
*******************************************************************************/
void Set_Pixel(unsigned int Color)
{
  LCD_DATA_OUT=Color;   //Color Data
  LCD_nWR_LOW();
  LCD_nWR_HIGH();
}

/*******************************************************************************
 Clear Screen 
*******************************************************************************/
void Clear_Screen(unsigned int Color)
{ 
  unsigned long i;
  Point_SCR(0, 0);    //X_pos=0£¬Y_pos=0
  for(i=0; i<240*320; ++i)
      Set_Pixel(Color);
}
/*******************************************************************************
 Display Frame 
*******************************************************************************/
void Display_Frame(void)                                                
{ 
  unsigned int i,j;
  for(i=0; i<320; ++i) {         
    Point_SCR(i,0); 
    for(j=0; j<MIN_Y-1; ++j) Set_Pixel(PANEL);
  }
  for(i=0; i<320; ++i) {         
    Point_SCR(i,MAX_Y+3);
    for(j=MAX_Y+3; j<240; ++j) Set_Pixel(PANEL);
  }
}
/*******************************************************************************
 Display Grid
*******************************************************************************/
void Display_Grid(void)                                                
{ 
  unsigned int i,j;
  for(j=MIN_Y; j<=MAX_Y; j+=25)  for(i=MIN_X; i<MAX_X+1; ++i){
    Point_SCR(i,j); 
    Set_Pixel(GRID);                                          
  }    
  for(i=MIN_X;i<=MAX_X; i+=25){
    Point_SCR(i,MIN_Y);
    for(j=MIN_Y; j<=MAX_Y; ++j) Set_Pixel(GRID);             
  }
  for(i=MIN_X+5; i<MAX_X; i+=5){
    Point_SCR(i,MIN_Y+1); 
    Set_Pixel(GRID);
    Point_SCR(i,MAX_Y-1); 
    Set_Pixel(GRID);
    Point_SCR(i,((MIN_Y+MAX_Y)/2+1)); 
    Set_Pixel(GRID);
    Point_SCR(i,((MIN_Y+MAX_Y)/2-1)); 
    Set_Pixel(GRID);                                          
  }
  for(j=MIN_Y+5; j<MAX_Y; j+=5){
    Point_SCR(MIN_X+1,j); 
    Set_Pixel(GRID);
    Point_SCR(MAX_X-1,j); 
    Set_Pixel(GRID);
    Point_SCR(((MIN_X+MAX_X)/2+1),j); 
    Set_Pixel(GRID);
    Point_SCR(((MIN_X+MAX_X)/2-1),j); 
    Set_Pixel(GRID);                                          
  }  
}


/*******************************************************************************
 Display_Char: Display Char   Input: X,Y, Color, Mode, char
*******************************************************************************/
void Display_Char(unsigned int x0, unsigned int y0, unsigned int Color, unsigned char Mode, char s)
{
  signed int i, j, b;
  
  Point_SCR(x0, y0);
  for (j=0; j<14;++j){
    if(Mode==0) Set_Pixel(BLACK);   //Normal replace Display
    if(Mode==1) Set_Pixel(Color);   //Inverse replace Display
  }
  
  x0++;
  if (s!=0) {
    unsigned const int *scanline=Char_Dot+((s-0x22)*8);
    for(i=0;i<8;++i){
      Point_SCR(x0+i, y0);
      if((s==0x20)||(s==0x21)) b=0x0000;
      else                       b=scanline[i];
      if((s==0x21)&&(i==4)) break;
      for(j=0;j<14;++j){
        if(b&4) {
          if(Mode==0) Set_Pixel(Color);
          if(Mode==1) Set_Pixel(BLACK);
          if(Mode==2) Set_Pixel(Color);
          if(Mode==3) Set_Pixel(BLACK);
        } else {
          if(Mode==0) Set_Pixel(BLACK);
          if(Mode==1) Set_Pixel(Color);
          if(Mode==2) Set_Pixel(BLACK);
          if(Mode==3) Set_Pixel(Color);
        }
        b>>=1;
      }
    }
    if(s==0x21) x0 +=4;
    else  x0 += 8;
  }
}

/*******************************************************************************
 Display_Str: Display String   Input: X¡¢Y, Color, Mode, String
*******************************************************************************/
void Display_Str(unsigned int x0, unsigned int y0, unsigned int Color, unsigned char Mode, unsigned const char *s)
{
  signed int i, j, b;
  Point_SCR(x0, y0);
  for (j=0; j<14;++j){
    if(Mode==0) Set_Pixel(BLACK);   //Normal replace Display
    if(Mode==1) Set_Pixel(Color);   //Inverse replace Display
  }
  x0++;
  while (*s!=0) {
    unsigned const int *scanline=Char_Dot+((*s-0x22)*8);
    for(i=0;i<8;++i){
      Point_SCR(x0+i, y0);
      if((*s==0x20)||(*s==0x21)) b=0x0000;
      else                       b=scanline[i];
      if((*s==0x21)&&(i==4)) break;
      for(j=0;j<14;++j){
        if(b&4) {
          if(Mode==0) Set_Pixel(Color);
          if(Mode==1) Set_Pixel(BLACK);
          if(Mode==2) Set_Pixel(Color);
          if(Mode==3) Set_Pixel(BLACK);
        } else {
          if(Mode==0) Set_Pixel(BLACK);
          if(Mode==1) Set_Pixel(Color);
          if(Mode==2) Set_Pixel(BLACK);
          if(Mode==3) Set_Pixel(Color);
        }
        b>>=1;
      }
    }
    if(*s==0x21) x0 +=4;
    else  x0 += 8;
    ++s;                           //next character
  }
}
/*******************************************************************************
 Display_Logo: Display Logo   Input: X, Y 
*******************************************************************************/
void Display_Logo(unsigned int Dot_x, unsigned int Dot_y)
{ 
  unsigned int i, j, k, Color; long b;
  for (i=0; i<256;++i) 
   {
    Point_SCR(Dot_x+i, Dot_y);
    for (j=0; j<2;++j) 
    {     
      b=Logo_Dot[(i*2)+j];
      for (k=0;k<32;++k)
      {
        if(b&0x80000000)
        { 
              Color=0x07E0; //Green?
        } 
        else Color=0;
        Set_Pixel(Color);
        b <<=1;
      }
    }
   }

 for(i=3; i<317; ++i)
  {
    Point_SCR(i, 3);
    Set_Pixel(0xFFFF);
    Point_SCR(i, 236);
    Set_Pixel(0xFFFF);
  }

  Point_SCR(0, 0);
  for(j=0; j<240; ++j) Set_Pixel(0xFFFF);
  Point_SCR(3, 3);
  for(j=3; j<237; ++j) Set_Pixel(0xFFFF);
  Point_SCR(316, 3);
  for(j=3; j<237; ++j) Set_Pixel(0xFFFF);
  Point_SCR(319, 0);
  for(j=0; j<240; ++j) Set_Pixel(0xFFFF);

}
  
/******************************** END OF FILE *********************************/